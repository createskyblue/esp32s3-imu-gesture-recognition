## components/lcd_lvgl/Kconfig
```kconfig
menu "LCD + LVGL"

config LCD_LVGL_BUF_IN_PSRAM
    bool "LVGL draw buffers in PSRAM (else internal DRAM)"
    default y
    help
        y = PSRAM buffers (keeps internal RAM free; required for the
        full-frame 240-row buffers used for 60 fps),
        n = internal DRAM buffers (only fits smaller row counts).

config LCD_LVGL_BENCHMARK
    bool "Run full-screen refresh + raw SPI benchmarks at startup"
    default n
    help
        When enabled, the display task prints RAW SPI throughput and a
        forced 30-frame full-screen refresh benchmark to the serial log
        at boot. Disable for normal operation.

endmenu
```

## components/led_task/Kconfig
```kconfig
menu "LED Task"

config LED_TASK_ENABLE
    bool "Enable LED task (board LEDs)"
    default n
    help
        Standalone four-channel LED driver. The LCKFB 立创实战派 ESP32-S3 board
        has no on-board LEDs (only the LCD backlight), so this is disabled by
        default. Enable it in menuconfig if your target board has LEDs.
        The code is kept in the tree and only linked when enabled.

endmenu
```

## main/Kconfig.projbuild
```kconfig
menuconfig BLE_ENABLED
    bool "BLE (Bluetooth Low Energy)"
    default y
    select BT_ENABLED
    select BT_NIMBLE_ENABLED
    help
        BLE 总开关（NimBLE host）。由 ble_host 组件统一拉起；配网/echo/主机
        等功能各自注册钩子。关闭则 BLE 相关组件都不编译，省约 40 KB SRAM。

menuconfig BLUFI_PROVISIONING_ENABLED
    bool "BluFi (BLE) WiFi provisioning"
    default y
    select BLE_ENABLED
    select BT_NIMBLE_BLUFI_ENABLE
    help
        BluFi 配网（依赖 BLE，开启会自动启用 BLE）。可用 EspBlufi App 或微信小程序
        BlufiEsp32WeChat（https://github.com/xuhongv/BlufiEsp32WeChat）配网。
```
